## builder/configs/iotfapos_defconfig
```kconfig
# iotfapOS-core Build Config
BR2_CCACHE=y
BR2_CCACHE_DIR="$(HOME)/.ccache-iotfapos-$(ARCH)"
#BR2_TOOLCHAIN_BUILDROOT_VENDOR="iotfap"
BR2_TOOLCHAIN_EXTERNAL=y
BR2_TARGET_ROOTFS_EXT2=y
BR2_TARGET_ROOTFS_EXT2_LABEL="corefs"
BR2_TARGET_ROOTFS_EXT2_RESBLKS=0
BR2_TARGET_ROOTFS_EXT2_MKFS_OPTIONS=" "
#BR2_TOOLCHAIN_BUILDROOT_CXX=y
#BR2_TOOLCHAIN_BUILDROOT_GLIBC=y
BR2_OPTIMIZE_2=y
BR2_GCC_VERSION_7_X=y
BR2_TARGET_GENERIC_PASSWD_SHA256=y
BR2_PACKAGE_HOST_DOSFSTOOLS=y
BR2_PACKAGE_HOST_GENIMAGE=y
BR2_PACKAGE_HOST_MTOOLS=y
BR2_PACKAGE_HOST_UBOOT_TOOLS=y
# Target Board Definition
TB_OEM="Asus"
TB_ID="asus-tinker"
TB_NAME="Asus Tinkerboard"
TB_ARCH="armhf"
TB_SOC="rk3288"
TB_PLATFORM=""
# Target Board Buildroot Config
BR2_arm=y
BR2_cortex_a17=y
BR2_ARM_FPU_NEON_VFPV4=y

#iotfapOS-Core Config
FAPOS_VER="0.2"
BR2_ENABLE_LOCALE_WHITELIST="C en_GB.UTF8 en_US"
BR2_TARGET_GENERIC_ISSUE="Welcome to iotfapOS-Core"
BR2_PACKAGE_BUSYBOX_CONFIG="configs/busybox.conf"
BR2_PACKAGE_BUSYBOX_INDIVIDUAL_BINARIES=y
BR2_PACKAGE_BUSYBOX_WATCHDOG=y
BR2_PACKAGE_BUSYBOX_WATCHDOG_PERIOD="60"
# BR2_TARGET_GENERIC_REMOUNT_ROOTFS_RW is not set
BR2_ROOTFS_DEVICE_CREATION_DYNAMIC_EUDEV=y
BR2_ROOTFS_MERGED_USR=y
BR2_TARGET_ROOTFS_EXT2_SIZE="128M"
BR2_TARGET_ROOTFS_SQUASHFS=y
BR2_TARGET_ROOTFS_SQUASHFS4_GZIP=y
BR2_TARGET_ROOTFS_CLOOP=y
BR2_TARGET_ROOTFS_CPIO=y
BR2_TARGET_ROOTFS_CPIO_GZIP=y
BR2_ROOTFS_POST_BUILD_SCRIPT="configs/hooks/post-build.sh"
BR2_ROOTFS_POST_FAKEROOT_SCRIPT="configs/hooks/fakeroot.sh"
BR2_ROOTFS_POST_IMAGE_SCRIPT="configs/hooks/post-image.sh"
BR2_PACKAGE_DROPBEAR=y
BR2_PACKAGE_DROPBEAR_CLIENT=y
BR2_PACKAGE_DROPBEAR_DISABLE_REVERSEDNS=y
# BR2_PACKAGE_DROPBEAR_SMALL is not set
BR2_PACKAGE_SUDO=y
BR2_PACKAGE_ETHTOOL=y
BR2_PACKAGE_DIALOG=y
BR2_PACKAGE_STUNNEL=y
BR2_PACKAGE_FAPSCRIPT=y
BR2_PACKAGE_PHP_EXT_SQLITE=y
BR2_PACKAGE_PHP_EXT_JSON=y

#asus-tinker kernel config
BR2_LINUX_KERNEL=n
BR2_PACKAGE_HOST_LINUX_HEADERS_CUSTOM_4_4=y
BR2_KERNEL_HEADERS_4_4=y
BR2_LINUX_KERNEL_CUSTOM_TARBALL=y
BR2_LINUX_KERNEL_CUSTOM_TARBALL_LOCATION="https://github.com/TinkerBoard/debian_kernel/archive/2.0.5.tar.gz"
BR2_LINUX_KERNEL_USE_CUSTOM_CONFIG=y
BR2_LINUX_KERNEL_CUSTOM_CONFIG_FILE="configs/board/config/linux.config"
BR2_LINUX_KERNEL_DTS_SUPPORT=y
BR2_LINUX_KERNEL_INTREE_DTS_NAME="rk3288-miniarm"
BR2_LINUX_KERNEL_NEEDS_HOST_OPENSSL=y
#asus-tinker uboot config
#BR2_TARGET_UBOOT=y
#BR2_TARGET_UBOOT_BUILD_SYSTEM_KCONFIG=y
#BR2_TARGET_UBOOT_CUSTOM_TARBALL=y
#BR2_TARGET_UBOOT_CUSTOM_TARBALL_LOCATION="https://github.com/TinkerBoard/debian_u-boot/archive/2.0.5.tar.gz"
#BR2_TARGET_UBOOT_USE_CUSTOM_CONFIG=y
#BR2_TARGET_UBOOT_CUSTOM_CONFIG_FILE="configs/board/config/uboot.config"
#BR2_TARGET_UBOOT_NEEDS_DTC=y
#BR2_TARGET_UBOOT_NEEDS_OPENSSL=y
#BR2_TARGET_UBOOT_FORMAT_DTB_BIN=y
#BR2_TARGET_UBOOT_FORMAT_DTB_IMG=y
#BR2_TARGET_UBOOT_SPL=y
#BR2_TARGET_UBOOT_SPL_NAME="spl/u-boot-spl-dtb.bin"
#iotfapOS-Core MyDevice Config
BR2_TARGET_GENERIC_HOSTNAME="iotfapOS"
BR2_TARGET_GENERIC_ROOT_PASSWD="iotfap"



#NAME="Default (blank)"

#NAME="Sys WiFi Tools"
BR2_PACKAGE_WIRELESS_TOOLS=y
BR2_PACKAGE_WPA_SUPPLICANT=y
BR2_PACKAGE_WPA_SUPPLICANT_AP_SUPPORT=y
BR2_PACKAGE_WPA_SUPPLICANT_EAP=y
BR2_PACKAGE_WPA_SUPPLICANT_DEBUG_SYSLOG=y
BR2_PACKAGE_WPA_SUPPLICANT_CLI=y
BR2_PACKAGE_WPA_SUPPLICANT_PASSPHRASE=y
#NAME="MySQL Service"
BR2_PACKAGE_MYSQL=y
BR2_PACKAGE_ORACLE_MYSQL=y
BR2_PACKAGE_ORACLE_MYSQL_SERVER=y
BR2_PACKAGE_HAS_MYSQL=y
BR2_PACKAGE_PROVIDES_MYSQL="oracle-mysql"
#NAME="GUI Core"
BR2_PACKAGE_WESTON=y
BR2_PACKAGE_WESTON_RDP=y
BR2_PACKAGE_WESTON_DRM=y
BR2_PACKAGE_WESTON_FBDEV=y
```

## buildstaq/template/corestaq_defconfig
```kconfig
# BUILD
BR2_CCACHE=y
BR2_CCACHE_DIR="$(HOME)/.cache/corestaq-ccache/$(ARCH)"
BR2_PACKAGE_HOST_DOSFSTOOLS=y
BR2_PACKAGE_HOST_GENIMAGE=y
BR2_PACKAGE_HOST_MTOOLS=y
BR2_ROOTFS_POST_BUILD_SCRIPT="template/post-build.sh"
BR2_ROOTFS_POST_FAKEROOT_SCRIPT="template/fakeroot.sh"
BR2_ROOTFS_POST_IMAGE_SCRIPT="template/post-image.sh"
BR2_GCC_VERSION_8_X=y
BR2_OPTIMIZE_S=y
#BR2_OPTIMIZE_2=y
#BR2_OPTIMIZE_3=y
BR2_ROOTFS_MERGED_USR=y
BR2_TARGET_ROOTFS_TAR=y
BR2_TARGET_ROOTFS_TAR_GZIP=y
BR2_TARGET_ROOTFS_EXT2=y
BR2_TARGET_ROOTFS_EXT2_4=y
BR2_TARGET_ROOTFS_EXT2_SIZE="64M"
BR2_TARGET_ROOTFS_EXT2_LABEL="corestaq"
BR2_TARGET_ROOTFS_EXT2_RESBLKS=0
BR2_TARGET_ROOTFS_EXT2_MKFS_OPTIONS=" "
BR2_TARGET_ROOTFS_SQUASHFS=y
BR2_TARGET_ROOTFS_SQUASHFS4_GZIP=y
BR2_TARGET_ROOTFS_CLOOP=y
BR2_TARGET_ROOTFS_CPIO=y
BR2_TARGET_ROOTFS_CPIO_GZIP=y

# PLATFORM
CSQ_PLATFORM="aarch64-generic"
BR2_aarch64=y
BR2_cortex_a53=y
BR2_TARGET_GENERIC_GETTY_PORT="ttyAMA0"

# DEVICE
CSQ_DEVICE="corestaq-emu-aarch64"
CSQ_PLATFORM="aarch64-generic"

#TOOLCHAIN
# host built
BR2_TOOLCHAIN_BUILDROOT=y
BR2_TOOLCHAIN_BUILDROOT_VENDOR="corestaq"
BR2_TOOLCHAIN_BUILDROOT_GLIBC=y
BR2_TOOLCHAIN_BUILDROOT_CXX=y


# CoreStaq BASE
#
BR2_PACKAGE_BUSYBOX_INDIVIDUAL_BINARIES=y
BR2_PACKAGE_BUSYBOX_CONFIG="template/corestaq-busybox.conf"
BR2_PACKAGE_BUSYBOX_WATCHDOG=y
BR2_PACKAGE_BUSYBOX_WATCHDOG_PERIOD="10"
BR2_SYSTEM_DHCP="eth0"
BR2_ROOTFS_DEVICE_CREATION_DYNAMIC_EUDEV=y
BR2_PACKAGE_SUDO=y
BR2_PACKAGE_ETHTOOL=y
BR2_PACKAGE_DIALOG=y
BR2_PACKAGE_STUNNEL=y
BR2_PACKAGE_DROPBEAR=y
BR2_PACKAGE_DROPBEAR_SMALL=n
BR2_PACKAGE_DROPBEAR_CLIENT=y
BR2_PACKAGE_DROPBEAR_DISABLE_REVERSEDNS=y

# PLATFORM KERNEL
BR2_LINUX_KERNEL=y
BR2_LINUX_KERNEL_CUSTOM_VERSION=y
BR2_LINUX_KERNEL_CUSTOM_VERSION_VALUE="4.19.57"
BR2_LINUX_KERNEL_USE_CUSTOM_CONFIG=y
BR2_LINUX_KERNEL_CUSTOM_CONFIG_FILE="template/linux.config"
BR2_PACKAGE_HOST_LINUX_HEADERS_CUSTOM_4_19=y
BR2_KERNEL_HEADERS_4_19=y

# MYDEVICE
BR2_TARGET_GENERIC_HOSTNAME="corestaq"
BR2_TARGET_GENERIC_ROOT_PASSWD="1234"
BR2_TARGET_GENERIC_ISSUE="Welcome to OpenCoreStaq"
BR2_ENABLE_LOCALE_WHITELIST="C en_GB.UTF8 en_US"
```

## corefs-builder/fs/Config.in
```kconfig
menu "Output Image"

source "fs/axfs/Config.in"
source "fs/cloop/Config.in"
source "fs/cpio/Config.in"
source "fs/ext2/Config.in"
source "fs/initramfs/Config.in"
source "fs/iso9660/Config.in"
source "fs/squashfs/Config.in"
source "fs/tar/Config.in"
source "fs/ubi/Config.in"
source "fs/ubifs/Config.in"

endmenu
```

## corefs-builder/package/fapscript/Config.in
```kconfig
config BR2_PACKAGE_FAPSCRIPT
	bool "FapScript"
	select BR2_PACKAGE_FAPSCRIPT_SAPI_CGI if \
	       !BR2_PACKAGE_FAPSCRIPT_SAPI_APACHE && \
	       !BR2_PACKAGE_FAPSCRIPT_SAPI_CLI && \
	       !BR2_PACKAGE_FAPSCRIPT_SAPI_FPM &&  \
	       BR2_USE_MMU
	select BR2_PACKAGE_FAPSCRIPT_SAPI_CLI if !BR2_USE_MMU
	depends on !BR2_BINFMT_FLAT
	help
	  iotfapOS embedded scripting enginge. a castrated php 7.2

if BR2_PACKAGE_FAPSCRIPT

config BR2_PACKAGE_FAPSCRIPT_SAPI_CGI
	bool "Enable modules"
	depends on BR2_USE_MMU
	help
	  Common Gateway Interface

source "package/fapscript/Config.ext"

endif
```

## corefs-builder/package/iotfapd/Config.in
```kconfig
config BR2_PACKAGE_IOTFAPD
	bool "iotfapd"
	help
	  iotfapd

if BR2_PACKAGE_IOTFAPD


source "package/iotfapd/Config.ext"

endif
```
